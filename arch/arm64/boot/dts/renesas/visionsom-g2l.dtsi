// SPDX-License-Identifier: (GPL-2.0-only OR BSD-2-Clause)
/*
 * Device Tree Source for VisionSOM-G2L SOM
 *
 * Copyright (C) 2023 Somlabs
 */

/dts-v1/;
#include "r9a07g044l2.dtsi"

#include "visionsom-x2l-pinfunction.dtsi"
#include "visionsom-x2l-common.dtsi"

/ {
	model = "Somlabs VisionSOM-G2L";
	compatible = "somlabs,visionsom-g2l", "renesas,r9a07g044l2", "renesas,r9a07g044";
};
